#ifndef WEBSERVER_MS
#define WEBSERVER_MS

#include <Arduino.h>
#include <ESP8266WiFi.h>
#include <ESP8266WiFiMulti.h>
#include <ESP8266WebServer.h>
#include <ESP8266mDNS.h>
#include <WebSocketsServer.h>
#include <Hash.h>
#include <ArduinoJson.h>
#include "webserver_ms.h"


static bool newSteerData = false;
static bool newPidData = false;
static float steerValsRecieved[2] = {0.0f};
static float pidValsRecieved[9] = {0.0f};

const char INDEX_HTML[] PROGMEM = {0X3C,0X21,0X44,0X4F,0X43,0X54,0X59,0X50,0X45,0X20,0X68,0X74,0X6D,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0X3E
};

ESP8266WiFiMulti WiFiMulti;
ESP8266WebServer server(80);
WebSocketsServer webSocket = WebSocketsServer(81);


// void initWebsocketServer(char hotspotName[], char hotspotPassword[]) {
//   WiFiMulti.addAP(hotspotName, hotspotPassword);
//   while (WiFiMulti.run() != WL_CONNECTED) {
//     delay(100);
//   }
//   Serial.println("WiFi connected");
//   Serial.println(WiFi.localIP());
//   webSocket.begin();
//   webSocket.onEvent(webSocketEvent);
//   if (MDNS.begin("Robot")) {
//     Serial.println("MDNS responder started");
//   }
//   server.on("/", []() {
//     server.send_P(200, "text/html", INDEX_HTML);
//   });
//   server.begin();
//   MDNS.addService("http", "tcp", 80);
//   MDNS.addService("ws", "tcp", 81);
// }

void initWebsocketServer(const char* hotspotName, const char* hotspotPassword, bool createHotspot) {
  if (createHotspot) {
    // Konfiguration als Hotspot (Access Point)

    IPAddress local_ip(192, 168, 1, 99);
    IPAddress gateway(192, 168, 1, 99);
    IPAddress subnet(255, 255, 255, 0);

    // Starten des Hotspots mit einer festen IP
    WiFi.softAPConfig(local_ip, gateway, subnet);
    WiFi.softAP(hotspotName, hotspotPassword);
    // Serial.println("Hotspot Mode: ON");
    // Serial.print("AP IP address: ");
    // Serial.println(WiFi.softAPIP());
  } else {
    // Verbindung zu einem vorhandenen WiFi-Netzwerk
    WiFiMulti.addAP(hotspotName, hotspotPassword);
    while (WiFiMulti.run() != WL_CONNECTED) {
      delay(100);
    }
    Serial.println("WiFi connected");
    Serial.print("Connected IP: ");
    Serial.println(WiFi.localIP());
  }

  webSocket.begin();
  webSocket.onEvent(webSocketEvent);
  MDNS.begin("Robot");

  server.on("/", []() {
    server.send_P(200, "text/html", INDEX_HTML);
  });

  server.begin();
  MDNS.addService("http", "tcp", 80);
  MDNS.addService("ws", "tcp", 81);
}

void webSocketEvent(uint8_t num, WStype_t type, uint8_t* payload, size_t length) {
  switch (type) {
    case WStype_DISCONNECTED:
      Serial.printf("[%u] Disconnected!\n", num);
      break;
    case WStype_CONNECTED:
      {
        IPAddress ip = webSocket.remoteIP(num);
        Serial.printf("[%u] Connected from %d.%d.%d.%d url: %s\n", num, ip[0], ip[1], ip[2], ip[3], payload);
        webSocket.sendTXT(num, "Connected");
      }
      break;
    case WStype_TEXT:
      JsonDocument doc;
      deserializeJson(doc, (char *) payload);
      if (doc["Mode"] == 1) {
        steerValsRecieved[0] = doc["ySteer"];
        steerValsRecieved[1] = doc["xSteer"];
        newSteerData = true;
      }
      else if (doc["Mode"] == 2) {
        pidValsRecieved[0] = doc["kpA"];
        pidValsRecieved[1] = doc["kiA"];
        pidValsRecieved[2] = doc["kdA"];
        pidValsRecieved[3] = doc["kpB"];
        pidValsRecieved[4] = doc["kiB"];
        pidValsRecieved[5] = doc["kdB"];
        pidValsRecieved[6] = doc["kpC"];
        pidValsRecieved[7] = doc["kiC"];
        pidValsRecieved[8] = doc["kdC"];
        newPidData = true;
      }
      break;
  }
}

void websocketRefresh() {
  webSocket.loop();
  MDNS.update();
  server.handleClient();
}

void websocketSendData(float websocketArray[8], uint32_t sendIntervall) {
  static uint32_t lastMillis = millis();
  uint32_t currentMillis = millis();
  if (currentMillis - lastMillis > sendIntervall) {
    lastMillis = currentMillis;
    char buffer[200];  // Stellen Sie sicher, dass der Buffer groß genug ist
    sprintf(buffer, "{\"distance\": %.2f,\"battery\": %.2f, \"speedL\": %.2f, \"speedR\": %.2f,\"posX\": %.3f, \"posY\": %.3f,\"anglePhi\": %.1f, \"angleAlpha\": %.2f}",
            websocketArray[0], websocketArray[1], websocketArray[2], websocketArray[3], websocketArray[4], websocketArray[5], websocketArray[6], websocketArray[7]);
    webSocket.broadcastTXT(buffer);
  }
}

bool websocketGetSteerData(float steerVals[2]) {
  if (newSteerData) {
    steerVals[0] = steerValsRecieved[0];
    steerVals[1] = steerValsRecieved[1];
    newSteerData = false;
    return true;
  }
  else return false;
}

bool websocketGetPidData(float pidVals[9]) {
  if (newPidData) {
    for (uint8_t i=0; i<9; i++) pidVals[i] = pidValsRecieved[i];
    newPidData = false;
    return true;
  }
  else return false;
}

#endif